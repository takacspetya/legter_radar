## main/Kconfig.projbuild
```kconfig
menu "Legter radar"

    config RADAR_WIFI_SSID
        string "WiFi network name (SSID)"
        default "halozat-neve"

    config RADAR_WIFI_PASSWORD
        string "WiFi password"
        default ""

    config RADAR_HOME_LAT
        string "Home latitude (radar center)"
        default "47.4979"

    config RADAR_HOME_LON
        string "Home longitude (radar center)"
        default "19.0402"

    config RADAR_UNITS_METRIC
        bool "Metric units (km, m, km/h) instead of nm, ft, kt"
        default y

    config RADAR_FETCH_INTERVAL_S
        int "Data refresh interval (seconds)"
        range 2 120
        default 10

    config RADAR_BUTTON_GPIO
        int "Button GPIO (active low)"
        range 0 48
        default 0

    menu "Display (GC9A01, SPI)"

        config RADAR_LCD_SIZE
            int "Resolution (square, pixels)"
            default 240

        config RADAR_LCD_SCK
            int "SCK GPIO"
            default 12

        config RADAR_LCD_MOSI
            int "MOSI GPIO"
            default 11

        config RADAR_LCD_CS
            int "CS GPIO"
            default 10

        config RADAR_LCD_DC
            int "DC GPIO"
            default 9

        config RADAR_LCD_RST
            int "RST GPIO (-1 if not connected)"
            range -1 48
            default 14

        config RADAR_LCD_BL
            int "Backlight GPIO (-1 if not connected)"
            range -1 48
            default 13

        config RADAR_LCD_SPI_MHZ
            int "SPI clock (MHz)"
            range 1 80
            default 40

        config RADAR_LCD_BGR
            bool "BGR color order (swap if red and blue are swapped)"
            default y

        config RADAR_LCD_INVERT
            bool "Invert colors"
            default y

        config RADAR_LCD_MIRROR_X
            bool "Mirror horizontally"
            default y

    endmenu

endmenu
```

## sdkconfig.defaults
```kconfig
CONFIG_IDF_TARGET="esp32s3"
CONFIG_ESPTOOLPY_FLASHSIZE_4MB=y
CONFIG_PARTITION_TABLE_SINGLE_APP_LARGE=y
CONFIG_COMPILER_OPTIMIZATION_PERF=y
CONFIG_FREERTOS_HZ=1000
CONFIG_ESP_MAIN_TASK_STACK_SIZE=8192
CONFIG_MBEDTLS_CERTIFICATE_BUNDLE=y
CONFIG_MBEDTLS_CERTIFICATE_BUNDLE_DEFAULT_FULL=y
```
